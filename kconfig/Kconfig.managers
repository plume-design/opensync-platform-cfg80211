## kconfig/Kconfig.managers
```kconfig
comment "Platform Managers"
rsource "../src/lib/nl80211/kconfig/Kconfig.managers"
```

## kconfig/Kconfig.osn.igmp_backend
```kconfig
#
# MTK IGMP implementation
#
if PLATFORM_IS_MTK
orsource "../src/lib/osn/kconfig/Kconfig.osn.igmp_backend"
endif
```

## kconfig/Kconfig.osn.mld_backend
```kconfig
#
# MTK MLD implementation
#
if PLATFORM_IS_MTK
orsource "../src/lib/osn/kconfig/Kconfig.osn.mld_backend"
endif
```

## kconfig/Kconfig.platform
```kconfig
menuconfig NL80211_INTERFACE_LAYER
    bool "NL80211 interface abstraction layer"
    default y
    help
        Enable NL80211 interface abstraction layer

menuconfig TARGE_USE_STATIC_NF
    bool "Use Static Noise Floor to Calculate SNR"
    default y
    help
        Add support for using static noise floor to calculate SNR

config MAC80211_WIPHY_PREFIX
    string "mac80211 wiphy prefix"
    default "phy"

config MAC80211_WIPHY_PATH
    string "mac80211 wiphy path"
    default "/sys/class/ieee80211"

config WIFI_UNUSED_IFACE_LIST
    string "Unused WiFi interfaces to be removed on WM init"
    default ""

config TARGET_USE_DPP
    bool "Use DPP for WPA Key Management"
    default n
    help
        Add support for WFA Easy Connect (DPP).

config CFG80211_NF_NAT_HELPERS
    bool "Use preferred OpenSync netfilter NAT helpers"
    default y
    help
        This will overwrite /etc/modules.d/nf-nathelper-extra
        with preferred OpenSync options.

config TARGET_USE_ANTENNA_AS_CHAIN
    bool "Use antenna mask directly as both TX/RX chain mask"
    default n

config TARGET_SUPPORT_WIFI7
    bool "Add support for WIFI 7"
    default n
    help
        Add support for WIFI 7.

menuconfig PLATFORM_IS_MTK
    bool "MediaTek"
    help
        Support for MediaTek platform

if PLATFORM_IS_MTK
config MTK_HW_ACC_HNAT
    bool "HNAT acceleration engine"
    default n
    help
        Use HNAT acceleration engine.

config MTK_HW_ACC_HNAT_FLUSH_PATH
    depends on MTK_HW_ACC_HNAT
    string "HNAT connection flush debug param"
    default "/sys/kernel/debug/hnat/hnat_entry"
    help
        Use this for flushing connection from HNAT AE.

config MTK_HW_ACC_HNAT_ENABLE_PATH
    depends on MTK_HW_ACC_HNAT
    string "HNAT enable/disable AE debug param"
    default "/sys/kernel/debug/hnat/hook_toggle"
    help
        Use this for enabling/disabling HNAT AE.

config MTK_HW_ACC_FILE_PATH
    depends on !MTK_HW_ACC_HNAT
    string "Hardware acceleration file path"
    default "/sys/kernel/debug/xt_flowoffload/flush"
    help
        This is the file where MAC addresses of OpenFlow rules
        are stored for flushing.

endif
```

## src/lib/nl80211/kconfig/Kconfig.managers
```kconfig
menuconfig NL80211_INTERFACE_LAYER
    bool "NL80211 interface abstraction layer"
    default y
    help
        Enable NL80211 interface abstraction layer
```

## src/lib/osn/kconfig/Kconfig.osn.igmp_backend
```kconfig
config OSN_BACKEND_IGMP_MTK
    bool "MTK mcproxy"

    select OSN_LINUX_ENABLED
    help
        Use the MTK `mcproxy` utility for managing IGMP.

        MTK platforms use mcproxy binary for correctly configuring up IGMP
        traffic.
```

## src/lib/osn/kconfig/Kconfig.osn.mld_backend
```kconfig
config OSN_BACKEND_MLD_MTK
    bool "MTK mcproxy"

    select OSN_LINUX_ENABLED
    help
        Use the MTK `mcproxy` utility for managing MLD.

        MTK platforms use mcproxy binary for correctly configuring up MLD
        traffic.
```

## src/lib/osn/kconfig/Kconfig.osn.qos_backend
```kconfig
config OSN_BACKEND_QOS_MTK
    bool "MTK hw qos"

    depends on PLATFORM_IS_MTK
    default n
    select OSN_LINUX_ENABLED
    help
        Use the MTK hw qos for qos management.
```
